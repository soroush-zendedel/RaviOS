## buildroot-external/Config.in
```kconfig
config BR2_RAVIOS_KERNEL_HEADERS_7_1
    bool
    default y if BR2_LINUX_KERNEL_CUSTOM_VERSION && BR2_KERNEL_HEADERS_AS_KERNEL
    select BR2_TOOLCHAIN_HEADERS_AT_LEAST_7_1

source "$BR2_EXTERNAL_RAVIOS_PATH/package/ravios-libdisplay-info-03/Config.in"
source "$BR2_EXTERNAL_RAVIOS_PATH/package/niri/Config.in"
source "$BR2_EXTERNAL_RAVIOS_PATH/package/ravios-gnome-desktop/Config.in"
source "$BR2_EXTERNAL_RAVIOS_PATH/package/ravios-appstream/Config.in"
source "$BR2_EXTERNAL_RAVIOS_PATH/package/ravios-iso-codes/Config.in"
source "$BR2_EXTERNAL_RAVIOS_PATH/package/ravios-xdg-desktop-portal/Config.in"
source "$BR2_EXTERNAL_RAVIOS_PATH/package/ravios-xdg-desktop-portal-gnome/Config.in"
source "$BR2_EXTERNAL_RAVIOS_PATH/package/ravios-session/Config.in"
```

## buildroot-external/configs/ravios_x86_64_defconfig
```kconfig
BR2_x86_64=y
BR2_TOOLCHAIN_BUILDROOT_CXX=y
BR2_DL_DIR="/workspace/dl"
BR2_CCACHE=y
BR2_TARGET_GENERIC_HOSTNAME="ravios"
BR2_TARGET_GENERIC_PASSWD_SHA512=y
BR2_ROOTFS_DEVICE_CREATION_DYNAMIC_EUDEV=y
BR2_TARGET_GENERIC_ROOT_PASSWD="ravios"
BR2_TARGET_GENERIC_GETTY_PORT="tty1"
BR2_ROOTFS_OVERLAY="$(BR2_EXTERNAL_RAVIOS_PATH)/rootfs-overlay"
BR2_ROOTFS_POST_BUILD_SCRIPT="$(BR2_EXTERNAL_RAVIOS_PATH)/board/ravios/x86_64/post-build.sh"
BR2_ROOTFS_POST_IMAGE_SCRIPT="$(BR2_EXTERNAL_RAVIOS_PATH)/board/ravios/x86_64/post-image.sh"
BR2_LINUX_KERNEL=y
BR2_LINUX_KERNEL_CUSTOM_VERSION=y
BR2_LINUX_KERNEL_CUSTOM_VERSION_VALUE="7.3.3"
BR2_LINUX_KERNEL_USE_CUSTOM_CONFIG=y
BR2_LINUX_KERNEL_CUSTOM_CONFIG_FILE="$(BR2_EXTERNAL_RAVIOS_PATH)/board/ravios/x86_64/linux.config"
BR2_LINUX_KERNEL_INSTALL_TARGET=y
BR2_LINUX_KERNEL_NEEDS_HOST_OPENSSL=y
BR2_LINUX_KERNEL_NEEDS_HOST_LIBELF=y
BR2_PACKAGE_GSTREAMER1=y
BR2_PACKAGE_GST1_PLUGINS_BASE=y
BR2_PACKAGE_GST1_PLUGINS_BASE_PLUGIN_APP=y
BR2_PACKAGE_PIPEWIRE=y
BR2_PACKAGE_WIREPLUMBER=y
BR2_PACKAGE_E2FSPROGS=y
BR2_PACKAGE_E2FSPROGS_RESIZE2FS=y
BR2_PACKAGE_MESA3D=y
BR2_PACKAGE_MESA3D_LLVM=y
BR2_PACKAGE_MESA3D_GALLIUM_DRIVER_IRIS=y
BR2_PACKAGE_MESA3D_GALLIUM_DRIVER_SVGA=y
BR2_PACKAGE_MESA3D_GALLIUM_DRIVER_SOFTPIPE=y
BR2_PACKAGE_MESA3D_OPENGL_EGL=y
BR2_PACKAGE_XKEYBOARD_CONFIG=y
BR2_PACKAGE_LINUX_FIRMWARE=y
BR2_PACKAGE_LINUX_FIRMWARE_ATHEROS_9170=y
BR2_PACKAGE_LINUX_FIRMWARE_ATHEROS_9271=y
BR2_PACKAGE_LINUX_FIRMWARE_IWLWIFI_3160=y
BR2_PACKAGE_LINUX_FIRMWARE_IWLWIFI_3168=y
BR2_PACKAGE_LINUX_FIRMWARE_IWLWIFI_5000=y
BR2_PACKAGE_LINUX_FIRMWARE_IWLWIFI_6000G2A=y
BR2_PACKAGE_LINUX_FIRMWARE_IWLWIFI_6000G2B=y
BR2_PACKAGE_LINUX_FIRMWARE_IWLWIFI_7260=y
BR2_PACKAGE_LINUX_FIRMWARE_IWLWIFI_7265D=y
BR2_PACKAGE_LINUX_FIRMWARE_IWLWIFI_8000C=y
BR2_PACKAGE_LINUX_FIRMWARE_IWLWIFI_8265=y
BR2_PACKAGE_LINUX_FIRMWARE_RALINK_RT73=y
BR2_PACKAGE_LINUX_FIRMWARE_RALINK_RT2XX=y
BR2_PACKAGE_LINUX_FIRMWARE_RTL_81XX=y
BR2_PACKAGE_LINUX_FIRMWARE_RTL_87XX=y
BR2_PACKAGE_LINUX_FIRMWARE_RTL_88XX=y
BR2_PACKAGE_LINUX_FIRMWARE_RTL_8169=y
BR2_PACKAGE_ACPID=y
BR2_PACKAGE_LUA=y
BR2_PACKAGE_ALSA_LIB=y
BR2_PACKAGE_CA_CERTIFICATES=y
BR2_PACKAGE_LIBFUSE3=y
BR2_PACKAGE_LIBGTK4=y
BR2_PACKAGE_LIBINPUT=y
BR2_PACKAGE_JSON_GLIB=y
BR2_PACKAGE_LIBXMLB=y
BR2_PACKAGE_LIBYAML=y
BR2_PACKAGE_LIBCURL=y
BR2_PACKAGE_GSETTINGS_DESKTOP_SCHEMAS=y
BR2_PACKAGE_CONNMAN=y
BR2_PACKAGE_CONNMAN_WIFI=y
BR2_PACKAGE_CONNMAN_CLIENT=y
BR2_PACKAGE_DROPBEAR=y
BR2_PACKAGE_WIRELESS_REGDB=y
BR2_PACKAGE_DOCKER_CLI=y
BR2_PACKAGE_DOCKER_ENGINE=y
BR2_PACKAGE_SEATD=y
BR2_PACKAGE_SEATD_BUILTIN=y
BR2_PACKAGE_SEATD_DAEMON=y
BR2_TARGET_ROOTFS_EXT2=y
BR2_TARGET_ROOTFS_EXT2_4=y
BR2_TARGET_ROOTFS_EXT2_SIZE="1333M"
# BR2_TARGET_ROOTFS_TAR is not set
BR2_TARGET_GRUB2=y
BR2_TARGET_GRUB2_X86_64_EFI=y
BR2_TARGET_GRUB2_INSTALL_TOOLS=y
BR2_PACKAGE_HOST_DOSFSTOOLS=y
BR2_PACKAGE_HOST_GENIMAGE=y
BR2_PACKAGE_HOST_MTOOLS=y
BR2_PACKAGE_RAVIOS_NIRI=y
BR2_PACKAGE_RAVIOS_GNOME_DESKTOP=y
BR2_PACKAGE_RAVIOS_ISO_CODES=y
BR2_PACKAGE_RAVIOS_XDG_DESKTOP_PORTAL=y
BR2_PACKAGE_RAVIOS_SESSION=y
BR2_GENERATE_LOCALE="en_US.UTF-8"
BR2_PACKAGE_FOOT=y
BR2_PACKAGE_MESA3D_OPENGL_ES=y

BR2_PACKAGE_FONTCONFIG=y
BR2_PACKAGE_FREETYPE=y
BR2_PACKAGE_DEJAVU=y


BR2_PACKAGE_MESA3D_GALLIUM_DRIVER_LLVMPIPE=y

BR2_PACKAGE_BLUEZ5_UTILS=y
BR2_PACKAGE_PIPEWIRE_SPA_BLUEZ=y

BR2_PACKAGE_LIBV4L=y
BR2_PACKAGE_PIPEWIRE_SPA_V4L2=y

BR2_PACKAGE_LIBCAMERA=y
BR2_PACKAGE_PIPEWIRE_SPA_LIBCAMERA=y

BR2_PACKAGE_PANGO=y

BR2_PACKAGE_UTIL_LINUX=y
BR2_PACKAGE_UTIL_LINUX_UNSHARE=y
```

## buildroot-external/package/niri/Config.in
```kconfig
config BR2_PACKAGE_RAVIOS_NIRI
    bool "Niri Wayland compositor"
    depends on BR2_x86_64
    depends on BR2_USE_WCHAR
    depends on BR2_TOOLCHAIN_HAS_THREADS
    depends on BR2_USE_MMU
    depends on BR2_INSTALL_LIBSTDCPP
    depends on BR2_TOOLCHAIN_HAS_SYNC_4
    depends on BR2_TOOLCHAIN_GCC_AT_LEAST_4_9
    depends on BR2_PACKAGE_DBUS
    depends on BR2_PACKAGE_PIPEWIRE
    depends on BR2_PACKAGE_LIBDRM
    depends on BR2_PACKAGE_LIBINPUT
    depends on BR2_PACKAGE_LIBXKBCOMMON
    depends on BR2_PACKAGE_MESA3D
    depends on BR2_PACKAGE_SEATD
    depends on BR2_PACKAGE_WAYLAND
    depends on BR2_PACKAGE_WAYLAND_PROTOCOLS
    depends on BR2_PACKAGE_PANGO
    select BR2_PACKAGE_RAVIOS_LIBDISPLAY_INFO_03
    help
      Niri scrollable-tiling Wayland compositor.
      DRM/KMS, EGL, GBM, libinput, libseat, OpenGL,
      D-Bus and PipeWire screencasting support.
      Systemd integration is disabled.

config BR2_PACKAGE_NIRI
    bool
    default y if BR2_PACKAGE_RAVIOS_NIRI
```

## buildroot-external/package/ravios-appstream/Config.in
```kconfig
config BR2_PACKAGE_RAVIOS_APPSTREAM
bool "AppStream"
depends on BR2_USE_MMU
depends on BR2_USE_WCHAR
depends on BR2_TOOLCHAIN_HAS_THREADS
depends on !BR2_STATIC_LIBS
select BR2_PACKAGE_LIBGLIB2
select BR2_PACKAGE_LIBCURL
select BR2_PACKAGE_LIBXML2
select BR2_PACKAGE_LIBYAML
select BR2_PACKAGE_LIBXMLB
help
  AppStream metadata library and command-line utility.
  Used by libadwaita for application metadata.

comment "AppStream needs a toolchain w/ wchar, threads, dynamic library"
depends on BR2_USE_MMU
depends on !BR2_USE_WCHAR || !BR2_TOOLCHAIN_HAS_THREADS || BR2_STATIC_LIBS
```

## buildroot-external/package/ravios-gnome-desktop/Config.in
```kconfig
config BR2_PACKAGE_RAVIOS_GNOME_DESKTOP
    bool "gnome-desktop"
    depends on BR2_USE_MMU
    depends on BR2_USE_WCHAR
    depends on BR2_TOOLCHAIN_HAS_THREADS
    depends on BR2_PACKAGE_LIBGTK4
    depends on BR2_PACKAGE_LIBGLIB2
    depends on BR2_PACKAGE_GDK_PIXBUF
    depends on BR2_PACKAGE_GSETTINGS_DESKTOP_SCHEMAS
    depends on BR2_PACKAGE_FONTCONFIG
    depends on BR2_PACKAGE_XKEYBOARD_CONFIG
    depends on BR2_PACKAGE_EUDEV
    depends on BR2_PACKAGE_LIBSECCOMP
    depends on BR2_PACKAGE_RAVIOS_ISO_CODES
    help
      GNOME Desktop support library for Wayland desktop environments.
```

## buildroot-external/package/ravios-iso-codes/Config.in
```kconfig
config BR2_PACKAGE_RAVIOS_ISO_CODES
    bool "ravios-iso-codes"
    help
      ISO code lists for GNOME Desktop.
```

## buildroot-external/package/ravios-libadwaita/Config.in
```kconfig
config BR2_PACKAGE_RAVIOS_LIBADWAITA
    bool "libadwaita"
    depends on BR2_USE_MMU
    depends on BR2_USE_WCHAR
    depends on BR2_TOOLCHAIN_HAS_THREADS
    depends on BR2_PACKAGE_LIBGTK4
    depends on BR2_PACKAGE_LIBGLIB2
    select BR2_PACKAGE_LIBFRIBIDI
    depends on BR2_PACKAGE_RAVIOS_APPSTREAM
    help
      GNOME adaptive UI library for GTK4.
      Required by GNOME desktop portal backend.
```

## buildroot-external/package/ravios-libdisplay-info-03/Config.in
```kconfig
config BR2_PACKAGE_RAVIOS_LIBDISPLAY_INFO_03
    bool "libdisplay-info 0.3.0 (RaviOS compatibility)"
    select BR2_PACKAGE_HWDATA
    select BR2_PACKAGE_HWDATA_PNP_IDS
    help
      libdisplay-info 0.3.0 required by Niri.
```

## buildroot-external/package/ravios-session/Config.in
```kconfig
config BR2_PACKAGE_RAVIOS_SESSION
    bool "RaviOS graphical session launcher"
    depends on BR2_PACKAGE_RAVIOS_NIRI
    depends on BR2_PACKAGE_DBUS
    depends on BR2_PACKAGE_PIPEWIRE
    depends on BR2_PACKAGE_WIREPLUMBER
    depends on BR2_PACKAGE_SEATD
    help
      SysV-compatible graphical session launcher for Niri.
      Starts a private D-Bus session, PipeWire and WirePlumber.
```

## buildroot-external/package/ravios-xdg-desktop-portal-gnome/Config.in
```kconfig
config BR2_PACKAGE_RAVIOS_XDG_DESKTOP_PORTAL_GNOME
    bool "xdg-desktop-portal-gnome"
    depends on BR2_USE_MMU
    depends on BR2_USE_WCHAR
    depends on BR2_TOOLCHAIN_HAS_THREADS
    depends on BR2_PACKAGE_RAVIOS_XDG_DESKTOP_PORTAL
    depends on BR2_PACKAGE_LIBGTK4
    depends on BR2_PACKAGE_RAVIOS_LIBADWAITA
    depends on BR2_PACKAGE_RAVIOS_GNOME_DESKTOP
    depends on BR2_PACKAGE_FONTCONFIG
    depends on BR2_PACKAGE_GSETTINGS_DESKTOP_SCHEMAS
    help
      GNOME backend for XDG Desktop Portal.
```

## buildroot-external/package/ravios-xdg-desktop-portal/Config.in
```kconfig
config BR2_PACKAGE_RAVIOS_XDG_DESKTOP_PORTAL
    bool xdg-desktop-portal
    depends on BR2_USE_MMU
    depends on BR2_USE_WCHAR
    depends on BR2_TOOLCHAIN_HAS_THREADS
    depends on BR2_PACKAGE_LIBGLIB2
    depends on BR2_PACKAGE_JSON_GLIB
    depends on BR2_PACKAGE_LIBFUSE3
    depends on BR2_PACKAGE_GDK_PIXBUF
    depends on BR2_PACKAGE_GSTREAMER1
    depends on BR2_PACKAGE_GST1_PLUGINS_BASE
    depends on BR2_PACKAGE_PIPEWIRE
    help
      XDG Desktop Portal frontend for Wayland desktop environments.
```
